## sdkconfig.defaults
```kconfig
CONFIG_MICRO_ROS_ESP_XRCE_DDS_MIDDLEWARE=y
CONFIG_MICRO_ROS_ESP_UART_TRANSPORT=y
CONFIG_MICROROS_UART_TXD=20
CONFIG_MICROROS_UART_RXD=19
CONFIG_MICROROS_UART_RTS=-1
CONFIG_MICROROS_UART_CTS=-1
```
